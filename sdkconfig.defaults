## sdkconfig.defaults
```kconfig
CONFIG_ESP_MAIN_TASK_STACK_SIZE=16384
CONFIG_HW_BUILD_VERSION_2=y
#
# Serial flasher config
#
CONFIG_ESPTOOLPY_FLASHSIZE_8MB=y
CONFIG_ESPTOOLPY_FLASHSIZE="8MB"
# CONFIG_LOG_DEFAULT_LEVEL_NONE=y

# end of Serial flasher config

#
# Partition Table
#
CONFIG_PARTITION_TABLE_CUSTOM=y
CONFIG_PARTITION_TABLE_CUSTOM_FILENAME="partitions.csv"
CONFIG_PARTITION_TABLE_FILENAME="partitions.csv"
CONFIG_PARTITION_TABLE_OFFSET=0xD000
# end of Partition Table

CONFIG_EXAMPLE_WIFI_SSID_PWD_FROM_STDIN=y
CONFIG_EXAMPLE_SOCKET_IP_INPUT_STDIN=y




# OTA Configuration
CONFIG_GITHUB_OWNER="ankayca"
CONFIG_GITHUB_REPO="EQDT"
# end of OTA Configuration




# Static Memory Optimization
#CONFIG_BT_STACK_NO_LOG=y
# end of Static Memory Optimization

# Static Memory Optimization
 CONFIG_BT_BLE_DYNAMIC_ENV_MEMORY=y
# end of Static Memory Optimization

# IRAM Optimization
CONFIG_COMPILER_OPTIMIZATION_SIZE=y
# CONFIG_FREERTOS_PLACE_FUNCTIONS_INTO_FLASH=y
# CONFIG_RINGBUF_PLACE_FUNCTIONS_INTO_FLASH=y
# CONFIG_FREERTOS_PLACE_SNAPSHOT_FUNS_INTO_FLASH=y
# CONFIG_ESP_WIFI_IRAM_OPT=n
# CONFIG_ESP_WIFI_RX_IRAM_OPT=n
# CONFIG_ESP_EVENT_POST_FROM_IRAM_ISR=n
# end of IRAM Optimization

## end of App Performance Configurations
```

## test/sdkconfig.defaults
```kconfig
CONFIG_ESP_TASK_WDT_EN=n
#
# Log output
#
# CONFIG_LOG_DEFAULT_LEVEL_NONE is not set
# CONFIG_LOG_DEFAULT_LEVEL_ERROR is not set
# CONFIG_LOG_DEFAULT_LEVEL_WARN is not set
CONFIG_LOG_DEFAULT_LEVEL_INFO=y
# CONFIG_LOG_DEFAULT_LEVEL_DEBUG is not set
# CONFIG_LOG_DEFAULT_LEVEL_VERBOSE is not set
CONFIG_LOG_DEFAULT_LEVEL=3
CONFIG_LOG_MAXIMUM_EQUALS_DEFAULT=y
# CONFIG_LOG_MAXIMUM_LEVEL_DEBUG is not set
# CONFIG_LOG_MAXIMUM_LEVEL_VERBOSE is not set
CONFIG_LOG_MAXIMUM_LEVEL=3
CONFIG_LOG_COLORS=y
CONFIG_LOG_TIMESTAMP_SOURCE_RTOS=y
# CONFIG_LOG_TIMESTAMP_SOURCE_SYSTEM is not set
# end of Log output
```
